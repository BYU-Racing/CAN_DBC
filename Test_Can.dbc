VERSION ""

NS_ :

BS_:

BU_:

BO_ 3221225472 VECTOR__INDEPENDENT_SIG_MSG: 0 Vector__XXX
 SG_ New_Signal_9 : 0|8@1- (1,0) [0|0] "" Vector__XXX

BO_ 4 RVC: 6 Vector__XXX
 SG_ Y_Rotation m4 : 8|32@1- (1,0) [-2147483648|2147483647] "" Vector__XXX
 SG_ Z_Rotation m5 : 8|32@1- (1,0) [-2147483648|2147483647] "" Vector__XXX
 SG_ X_Rotation m3 : 8|32@1- (1,8) [-2147483640|2147483655] "" Vector__XXX
 SG_ Z_Acceleration m2 : 8|32@1- (1,8) [-2147483640|2147483655] "" Vector__XXX
 SG_ Y_Acceleration m1 : 8|32@1- (1,8) [-2147483640|2147483655] "" Vector__XXX
 SG_ X_Acceleration m0 : 8|32@1- (1,8) [-2147483640|2147483655] "" Vector__XXX
 SG_ RVC_MultiPlex M : 0|8@1+ (1,0) [0|255] "" Vector__XXX

BO_ 9 GPS: 8 Vector__XXX
 SG_ GPSLatitude : 32|32@1- (1,0) [-2147483648|2147483647] "" Vector__XXX
 SG_ GPSLongitude : 0|32@1- (1,32) [-2147483616|2147483679] "" Vector__XXX

BO_ 0 StartSwitch: 1 Vector__XXX
 SG_ StartSwitch : 0|8@1+ (1,0) [0|1] "" Vector__XXX

BO_ 1 Throttle1Position: 2 Vector__XXX
 SG_ Throttle1Position : 0|16@1+ (1,0) [0|65535] "" Vector__XXX

BO_ 2 Throttle2Position: 2 Vector__XXX
 SG_ Throttle2Position : 0|16@1+ (1,0) [0|65535] "" Vector__XXX

BO_ 3 BrakePressure: 2 Vector__XXX
 SG_ Brake : 0|16@1+ (1,0) [0|65535] "" Vector__XXX

CM_ BO_ 3221225472 "This is a message for not used signals, created by Vector CANdb++ DBC OLE DB Provider.";
CM_ SG_ 1 Throttle1Position "throttle 1 pos sensor";
CM_ SG_ 2 Throttle2Position "Throttle 2 pos sensor";
CM_ SG_ 3 Brake "Brake sensor";
BA_DEF_  "BusType" STRING ;
BA_DEF_DEF_  "BusType" "CAN";
